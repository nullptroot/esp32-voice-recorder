## firmware/sdkconfig.defaults
```kconfig
# 录音豆固件默认配置 (ESP-IDF v5.5.x)
CONFIG_IDF_TARGET="esp32s3"

# Flash 8MB
CONFIG_ESPTOOLPY_FLASHSIZE_8MB=y
CONFIG_ESPTOOLPY_FLASHSIZE="8MB"

# PSRAM: R8N8 -> 8MB Octal PSRAM @80MHz
CONFIG_SPIRAM=y
CONFIG_SPIRAM_MODE_OCT=y
CONFIG_SPIRAM_SPEED_80M=y
CONFIG_SPIRAM_USE_MALLOC=y
CONFIG_SPIRAM_MALLOC_ALWAYSINTERNAL=32768
CONFIG_SPIRAM_TRY_ALLOCATE_WIFI_LWIP=y

# 240MHz, 1kHz tick (I2S/SD 时序友好)
CONFIG_ESP_DEFAULT_CPU_FREQ_MHZ_240=y
CONFIG_FREERTOS_HZ=1000

# 分区表
CONFIG_PARTITION_TABLE_CUSTOM=y
CONFIG_PARTITION_TABLE_CUSTOM_FILENAME="partitions.csv"
CONFIG_PARTITION_TABLE_FILENAME="partitions.csv"

# 控制台: UART0 (板载 CH340 -> /dev/ttyUSB0)
CONFIG_ESP_CONSOLE_UART_DEFAULT=y
CONFIG_ESP_CONSOLE_UART_BAUDRATE=115200

# 任务看门狗: 录音时会阻塞写卡, 先关闭初始化, 由应用层自检
CONFIG_ESP_TASK_WDT_INIT=n

# FatFS: 长文件名 + UTF-8
CONFIG_FATFS_LFN_HEAP=y
CONFIG_FATFS_SECTOR_512=y
CONFIG_FATFS_SECTOR_4096=n
CONFIG_FATFS_MAX_LFN=255
CONFIG_FATFS_CODEPAGE_437=y

# HTTP server / client
CONFIG_HTTPD_MAX_REQ_HDR_LEN=2048
CONFIG_HTTPD_MAX_URI_LEN=512
CONFIG_ESP_HTTP_CLIENT_ENABLE_HTTPS=y

# LWIP
CONFIG_LWIP_MAX_SOCKETS=10

# 主任务栈
CONFIG_ESP_MAIN_TASK_STACK_SIZE=8192
CONFIG_ESP_SYSTEM_EVENT_TASK_STACK_SIZE=4096

# 日志
CONFIG_LOG_DEFAULT_LEVEL_INFO=y
CONFIG_LOG_DEFAULT_LEVEL=3

# WiFi: 关闭省电, 上传更快
CONFIG_ESP_WIFI_SLP_DEFAULT_MIN_ACTIVE_TIME=0

# 不启用安全启动/加密
CONFIG_SECURE_BOOT=n
CONFIG_SECURE_FLASH_ENC_ENABLED=n
```
